## sdkconfig.defaults
```kconfig
# Common defaults (target-specific options: sdkconfig.defaults.esp32c6)
CONFIG_ESPTOOLPY_FLASHSIZE_4MB=y
CONFIG_COMPILER_OPTIMIZATION_PERF=y

# Bluetooth (controller only; C6 BLE details in sdkconfig.defaults.esp32c6)
CONFIG_BT_ENABLED=y
CONFIG_BT_CONTROLLER_ONLY=y

# BTstack
CONFIG_BTSTACK_AUDIO=n

# FreeRTOS
CONFIG_FREERTOS_HZ=1000
CONFIG_FREERTOS_USE_TRACE_FACILITY=y
CONFIG_FREERTOS_USE_STATS_FORMATTING_FUNCTIONS=y

# WiFi 비활성화 (불필요)
CONFIG_ESP_WIFI_ENABLED=n

# Bluepad32
CONFIG_BLUEPAD32_MAX_DEVICES=4
CONFIG_BLUEPAD32_PLATFORM_CUSTOM=y
CONFIG_BLUEPAD32_USB_CONSOLE_ENABLE=y
```
